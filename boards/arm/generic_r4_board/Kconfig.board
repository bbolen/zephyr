## boards/arm/generic_r4_board/Kconfig.board
```kconfig
#
# SPDX-License-Identifier: Apache-2.0
#
config BOARD_GENERIC_R4_BOARD
	bool "Generic R4 Board"
	depends on SOC_R4SOC
```

## boards/arm/generic_r4_board/Kconfig.defconfig
```kconfig
#
# SPDX-License-Identifier: Apache-2.0
#

if BOARD_GENERIC_R4_BOARD

config BOARD
	default "generic_r4_board"

config BUILD_OUTPUT_STRIPPED
	def_bool y

endif
```

## boards/arm/generic_r4_board/generic_r4_board_defconfig
```kconfig
CONFIG_ARM=y
CONFIG_BOARD_GENERIC_R4_BOARD=y
CONFIG_SOC_R4SOC=y
CONFIG_XIP=n

CONFIG_ISR_STACK_SIZE=512
CONFIG_THREAD_STACK_INFO=y

# enable uart driver
CONFIG_SERIAL=y

# enable console
CONFIG_CONSOLE=y
CONFIG_UART_CONSOLE=y

# enable serial port
CONFIG_UART_NS16550=y
CONFIG_UART_NS16550_PORT_0=y

CONFIG_SYS_CLOCK_TICKS_PER_SEC=1000
```

## dts/bindings/interrupt-controller/arm,gic.yaml
```yaml
#
# Copyright (c) 2018 Marvell
#
# SPDX-License-Identifier: Apache-2.0
#
---
title: ARMv7-R Generic Interrupt Controller
version: 0.1

description: >
    This binding describes the ARM Generic Interrupt Controller.

properties:
    compatible:
      category: required
      type: string
      description: compatible strings
      constraint: "arm,gic"
      generation: define

    reg:
      category: required
      type: int
      description: mmio register space
      generation: define

    label:
      category: required
      type: string
      description: Human readable string describing the device (used by Zephyr for API name)
      generation: define

cell_string: IRQ

"#cells":
  - irq
  - priority
  - flags
...
```

## soc/arm/r4soc/Kconfig.defconfig
```kconfig
#
# Copyright (c) 2014-2015 Wind River Systems, Inc.
#
# SPDX-License-Identifier: Apache-2.0
#

if SOC_R4SOC

config SOC
	default "r4soc"

config NUM_IRQS
	int
	# must be >= the highest interrupt number used
	# - include the UART interrupts
	default 220

config 2ND_LVL_ISR_TBL_OFFSET
	default 1

config MAX_IRQ_PER_AGGREGATOR
	default 219

config NUM_2ND_LEVEL_AGGREGATORS
	default 1

config SYS_CLOCK_HW_CYCLES_PER_SEC
	int
	default 12000000

endif
```

## soc/arm/r4soc/Kconfig.soc
```kconfig
config SOC_R4SOC
	bool "R4Soc"
	select CPU_CORTEX_R4
	select GIC
	select MULTI_LEVEL_INTERRUPTS
	select 2ND_LEVEL_INTERRUPTS
```
